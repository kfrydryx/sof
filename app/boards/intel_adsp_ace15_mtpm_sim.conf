## app/boards/intel_adsp_ace15_mtpm_sim.conf
```kconfig
CONFIG_METEORLAKE=y
CONFIG_INTEL_DMIC=y
CONFIG_INTEL_DMIC_NHLT=y
CONFIG_DMIC_HW_IOCLK=19200000
CONFIG_INTEL_SSP=y
CONFIG_COMP_SRC=n
CONFIG_IPC_MAJOR_4=y
CONFIG_INTEL_ALH=y
CONFIG_LP_MEMORY_BANKS=1
CONFIG_HP_MEMORY_BANKS=22
CONFIG_RIMAGE_SIGNING_SCHEMA="mtl"
CONFIG_PCM_CONVERTER_FORMAT_S16_C16_AND_S16_C32=y
CONFIG_PCM_CONVERTER_FORMAT_S16_C32_AND_S32_C32=y
CONFIG_PCM_CONVERTER_FORMAT_S16_C32_AND_S24_C32=y
CONFIG_PCM_CONVERTER_FORMAT_S24_C24_AND_S24_C32=y
CONFIG_PCM_CONVERTER_FORMAT_S24_C32_AND_S24_C24=y
CONFIG_PCM_CONVERTER_FORMAT_S16_C32_AND_S16_C32=y
CONFIG_PM=y
CONFIG_PM_DEVICE=y
CONFIG_PM_DEVICE_RUNTIME=y
CONFIG_PM_DEVICE_POWER_DOMAIN=n
```

## src/arch/xtensa/configs/mtl_defconfig
```kconfig
CONFIG_METEORLAKE=y
CONFIG_ACE=y
CONFIG_ACE_VERSION_1_0=y
CONFIG_RIMAGE_SIGNING_SCHEMA="mtl"
CONFIG_INTEL_DMIC=y
CONFIG_INTEL_DMIC_NHLT=y
CONFIG_DMIC_HW_IOCLK=38400000
CONFIG_INTEL_SSP=y
CONFIG_INTEL_ALH=y
CONFIG_CORE_COUNT=2
CONFIG_LP_MEMORY_BANKS=0
CONFIG_HP_MEMORY_BANKS=22
CONFIG_L1_DRAM=n
CONFIG_L1_DRAM_MEMORY_BANKS=0
CONFIG_L1_DRAM_MEMORY_BANK_SIZE=0
CONFIG_IPC_MAJOR_4=y
CONFIG_COMP_VOLUME_WINDOWS_FADE=y
CONFIG_FORMAT_CONVERT_HIFI3=n
CONFIG_PCM_CONVERTER_FORMAT_S16_C16_AND_S16_C32=y
CONFIG_PCM_CONVERTER_FORMAT_S16_C32_AND_S32_C32=y
CONFIG_PCM_CONVERTER_FORMAT_S16_C32_AND_S24_C32=y
CONFIG_PCM_CONVERTER_FORMAT_S24_C24_AND_S24_C32=y
CONFIG_PCM_CONVERTER_FORMAT_S24_C32_AND_S24_C24=y
CONFIG_PCM_CONVERTER_FORMAT_S16_C32_AND_S16_C32=y
```

## west.yml
```yaml
# SOF west manifest
manifest:
  version: "0.13"

  defaults:
    remote: innersource

  remotes:
    - name: thesofproject
      url-base: https://github.com/thesofproject
    - name: zephyrproject
      url-base: https://github.com/zephyrproject-rtos
    - name: innersource
      url-base: https://github.com/intel-innersource

  projects:
    - name: rimage
      repo-path: drivers.audio.firmware.rimage
      path: sof/rimage
      revision: 135dcf5b4010d76e13d1e0b4230ff584ad9bfe6c

    - name: tomlc99
      remote: thesofproject
      repo-path: tomlc99
      path: sof/rimage/tomlc99
      revision: e3a03f5ec7d8d33be705c5ce8a632d998ce9b4d1

    - name: zephyr
      repo-path: os.rtos.zephyr.zephyr
      path: zephyr
      revision: a4fb0ebab9c50979c0be8d4f7649e424b561da5f
      import:
        name-whitelist:
          - hal_xtensa
          - mbedtls
          - mipi-sys-t
          - lz4
          - tinycrypt

  self:
    path: sof
    import: submanifests
```
